## config/boards/shields/soflex/Kconfig.defconfig
```kconfig
# Copyright (c) 2020 Ryan Cross
# SPDX-License-Identifier: MIT

if SHIELD_SOFLEX_LEFT
config ZMK_KEYBOARD_NAME
    default "SofleX"
config ZMK_SPLIT_ROLE_CENTRAL
    default y
endif

if SHIELD_SOFLEX_LEFT || SHIELD_SOFLEX_RIGHT
config ZMK_SPLIT
    default y
endif
```

## config/boards/shields/soflex/Kconfig.shield
```kconfig
# Copyright (c) 2020 Ryan Cross
# SPDX-License-Identifier: MIT

config SHIELD_SOFLEX_LEFT
    def_bool $(shields_list_contains,soflex_left)

config SHIELD_SOFLEX_RIGHT
    def_bool $(shields_list_contains,soflex_right)
```
